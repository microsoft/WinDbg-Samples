; This ARM64 trace32 cmm script file is used by the windbg.exe-ExdiGdbSrv.dll-T32-GdbServer solution
; in order to ensure that t32.exe breaks and leaves the target in a Kernel mode context, so
; ExdiGdbSrv (gdb client) does not have to check for the current CPU mode before sending
; trace32 RSP memory packets when it tries to access NT objects.
; This script executes the following actions:
; Attach to the target
; Break into the target (it can be in any random context user or kernel mode context)
; Wait for the target to break
; if succeed, the read the system registers (SPR in arm64) for reading the vector base address (CP15_VBAR, nt!KiArm64ExceptionVectors)
; if the read succeed, the it verifies if we are already in kernel mode, if yes, the exit the scrip
; if no, then set a breakpoint on the address obtained by reading the SPR register
; Run the target
; Wait for 5 seconds or until the target break
; Verifies that we broke in the expected address and we are in kernel mode
; if yes, then exits and remove the breakpoint and display succeed message
; if no, then we remove the breakpoint and exit with displaying the error
;
TRANSlation.ON
TRANSlation.TableWalk ON
ON ERROR CONTinue
SYStem.Config slave off
SYStem.JtagClock 15mhz
SYStem.Option DCacheMaintenance SetWay
;SYStem.Option CFLUSH ON
SYStem.Mode Attach
&break_attempt=0.

;work around running(no power)
WHILE STATE.RUN()
(
  wait 500.ms
  Break.direct ;
  &break_attempt=&break_attempt+1.
  IF (&break_attempt==20.)
  (
   print %ERROR "could not stop the target after attach!"
   ENDDO
  )
)

CORE 0.
&cpsr_register=Register(CPSR) 
&EL=&cpsr_register&0x1F

IF (&EL==0x9||&EL==0x8)
(
  print "successfully stopped at EL2"
  Break.Delete
  ENDDO
)

; If not at EL2 try to run till going into EL2

&vbar_el2= Data.Quad(SPR:0x34C00)                      ; read Hypervisor Vector Base address register
Break.Set     NX:&vbar_el2 /Program /Onchip            ; set onchip break point at Vector Base address

WHILE TRUE()
(
  Go
  WAIT !run() 8.s

  IF STATE.RUN()
  (
   print %ERROR "could not stop the target!"
   Break.delete
   ENDDO
  )
  CORE 0.
  &cpsr_register=Register(CPSR) 
  &EL=&cpsr_register&0x1F

  IF (&EL==0x9||&EL==0x8)
  (
    print "successfully stopped at EL2"
    Break.Delete
    ENDDO
  )
)


